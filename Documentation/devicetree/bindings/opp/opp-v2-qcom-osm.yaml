## Documentation/devicetree/bindings/opp/opp-v2-qcom-osm.yaml
```yaml
# SPDX-License-Identifier: (GPL-2.0-only OR BSD-2-Clause)
%YAML 1.2
---
$id: http://devicetree.org/schemas/opp/opp-v2-qcom-osm.yaml#
$schema: http://devicetree.org/meta-schemas/core.yaml#

title: Qualcomm OSM CPU OPP

maintainers:
  - Noa Himesaka <himesaka@noa.codes>

allOf:
  - $ref: opp-v2-base.yaml#

description:
  CPU OPP table of a cluster whose OSM (Operating State Manager) look-up
  table is programmed by the OS, as on SDM630/SDM636/SDM660 where the
  boot firmware leaves it empty. Next to the frequency, every OPP carries
  the raw OSM fields of its look-up table entry, and its CPR corner through
  required-opps.

properties:
  compatible:
    const: operating-points-v2-qcom-osm

  opp-shared: true

patternProperties:
  '^opp-?[0-9]+$':
    type: object
    additionalProperties: false

    properties:
      opp-hz: true

      opp-supported-hw: true

      required-opps: true

      turbo-mode: true

      qcom,pll-override:
        description:
          PLL override word of this frequency's OSM look-up table entry.
        $ref: /schemas/types.yaml#/definitions/uint32

      qcom,spare-data:
        description:
          Spare data field of this frequency's OSM look-up table entry.
          Defaults to 0 if absent.
        $ref: /schemas/types.yaml#/definitions/uint32

      qcom,pll-div:
        description:
          Divider field of this frequency's OSM look-up table entry.
          Defaults to 0 if absent.
        $ref: /schemas/types.yaml#/definitions/uint32

    required:
      - opp-hz
      - required-opps
      - qcom,pll-override

required:
  - compatible

additionalProperties: false

examples:
  - |
    opp-table {
        compatible = "operating-points-v2-qcom-osm";
        opp-shared;

        opp-300000000 {
            opp-hz = /bits/ 64 <300000000>;
            required-opps = <&cprh_opp1>;
            qcom,pll-override = <0x1200020>;
            qcom,spare-data = <1>;
        };

        opp-633600000 {
            opp-hz = /bits/ 64 <633600000>;
            required-opps = <&cprh_opp2>;
            qcom,pll-override = <0x3200020>;
            qcom,spare-data = <1>;
            qcom,pll-div = <1>;
        };
    };
```

## Documentation/devicetree/bindings/power/avs/qcom,cprh.yaml
```yaml
# SPDX-License-Identifier: GPL-2.0-only OR BSD-2-Clause
%YAML 1.2
---
$id: http://devicetree.org/schemas/power/avs/qcom,cprh.yaml#
$schema: http://devicetree.org/meta-schemas/core.yaml#

title: Qualcomm Core Power Reduction Hardened (CPRh)

maintainers:
  - Noa Himesaka <himesaka@noa.codes>

description: |
  CPRh is the hardware-managed variant of Core Power Reduction found on the
  application CPU clusters of some Qualcomm SoCs. The OS programs the voltage
  and quotient tables, computed from fuse data, and the hardware (OSM) then
  requests voltages from the PMIC on its own, so the regulator is not accessed
  by the OS. Each register region is one CPR thread (CPU cluster).

  The OPP table referenced by operating-points-v2 holds the virtual corners
  (operating-points-v2-qcom-level). The CPU OPP tables select a corner with
  required-opps.

properties:
  compatible:
    enum:
      - qcom,msm8998-cprh
      - qcom,sdm630-cprh
      - qcom,sdm660-cprh

  reg:
    minItems: 1
    maxItems: 2
    description: Register region of each CPR thread, in thread order.

  clocks:
    items:
      - description: Reference clock.

  clock-names:
    items:
      - const: ref

  operating-points-v2:
    description: Phandle to the OPP table of virtual corners.

  power-domains:
    maxItems: 1
    description: Parent power domain providing the voltage rail.

  '#power-domain-cells':
    const: 1

  nvmem-cells:
    minItems: 2
    maxItems: 64
    description: Fuse cells holding speed bin, fuse revision and per-thread
      quotients, quotient offsets, initial voltages and ring oscillator
      selections.

  nvmem-cell-names:
    minItems: 2
    maxItems: 64
    items:
      anyOf:
        - enum:
            - cpr_speed_bin
            - cpr_fuse_revision
        - pattern: '^cpr[0-9]_(quotient[1-9]|quotient_offset[2-9]|init_voltage[1-9]|ring_osc[1-9])$'

required:
  - compatible
  - reg
  - clocks
  - clock-names
  - operating-points-v2
  - '#power-domain-cells'
  - nvmem-cells
  - nvmem-cell-names

additionalProperties: false

examples:
  - |
    #include <dt-bindings/clock/qcom,gcc-sdm660.h>
    #include <dt-bindings/power/qcom-rpmpd.h>

    power-controller@179c8000 {
        compatible = "qcom,sdm660-cprh";
        reg = <0x179c8000 0x4000>, <0x179c4000 0x4000>;

        clocks = <&gcc GCC_HMSS_RBCPR_CLK>;
        clock-names = "ref";

        operating-points-v2 = <&cprh_opp_table>;
        power-domains = <&rpmpd SDM660_VDDCX_AO>;
        #power-domain-cells = <1>;

        nvmem-cells = <&cpr_efuse_speedbin>, <&cpr_fuse_revision>;
        nvmem-cell-names = "cpr_speed_bin", "cpr_fuse_revision";
    };
```

## Documentation/devicetree/bindings/usb/qcom,pmi8998-typec.yaml
```yaml
# SPDX-License-Identifier: (GPL-2.0-only OR BSD-2-Clause)
%YAML 1.2
---
$id: http://devicetree.org/schemas/usb/qcom,pmi8998-typec.yaml#
$schema: http://devicetree.org/meta-schemas/core.yaml#

title: Qualcomm PMI8998/PM660 SMB2 Type-C port with PD PHY

maintainers:
  - Daniel Roussel <224128+daniel-k@users.noreply.github.com>

description:
  The Type-C detection of the PMI8998 and PM660 PMICs is part of the SMB2
  charger's USBIN peripheral. It reports attach, CC and VBUS changes through a
  single interrupt. The PD PHY is a separate peripheral, the same as on
  PM8150B.

properties:
  compatible:
    oneOf:
      - const: qcom,pmi8998-typec
      - items:
          - const: qcom,pm660-typec
          - const: qcom,pmi8998-typec

  reg:
    items:
      - description: SMB2 USBIN (Type-C) base
      - description: PD PHY base

  interrupts:
    items:
      - description: Type-C CC, debounce or VBUS state change
      - description: PD signal TX - HardReset or CableReset signal TX
      - description: PD signal RX - HardReset or CableReset signal RX
      - description: PD TX complete
      - description: PD RX complete
      - description: PD TX fail
      - description: PD TX message discard
      - description: PD RX message discard

  interrupt-names:
    items:
      - const: type-c-change
      - const: sig-tx
      - const: sig-rx
      - const: msg-tx
      - const: msg-rx
      - const: msg-tx-failed
      - const: msg-tx-discarded
      - const: msg-rx-discarded

  vdd-vbus-supply:
    description: VBUS output, the charger's OTG boost.

  vdd-pdphy-supply:
    description: VDD regulator supply to the PD PHY.

  connector:
    type: object
    $ref: /schemas/connector/usb-connector.yaml#
    unevaluatedProperties: false

required:
  - compatible
  - reg
  - interrupts
  - interrupt-names
  - vdd-vbus-supply
  - vdd-pdphy-supply
  - connector

additionalProperties: false

examples:
  - |
    #include <dt-bindings/interrupt-controller/irq.h>
    #include <dt-bindings/usb/pd.h>

    pmic {
        #address-cells = <1>;
        #size-cells = <0>;

        typec@1300 {
            compatible = "qcom,pm660-typec", "qcom,pmi8998-typec";
            reg = <0x1300>, <0x1700>;
            interrupts = <0x0 0x13 0x7 IRQ_TYPE_EDGE_RISING>,
                         <0x0 0x17 0x0 IRQ_TYPE_EDGE_RISING>,
                         <0x0 0x17 0x1 IRQ_TYPE_EDGE_RISING>,
                         <0x0 0x17 0x2 IRQ_TYPE_EDGE_RISING>,
                         <0x0 0x17 0x3 IRQ_TYPE_EDGE_RISING>,
                         <0x0 0x17 0x4 IRQ_TYPE_EDGE_RISING>,
                         <0x0 0x17 0x5 IRQ_TYPE_EDGE_RISING>,
                         <0x0 0x17 0x6 IRQ_TYPE_EDGE_RISING>;
            interrupt-names = "type-c-change",
                              "sig-tx",
                              "sig-rx",
                              "msg-tx",
                              "msg-rx",
                              "msg-tx-failed",
                              "msg-tx-discarded",
                              "msg-rx-discarded";
            vdd-vbus-supply = <&pm660_vbus>;
            vdd-pdphy-supply = <&vreg_l7b>;

            connector {
                compatible = "usb-c-connector";
                power-role = "dual";
                data-role = "dual";
                try-power-role = "sink";
                self-powered;
                source-pdos = <PDO_FIXED(5000, 1500, PDO_FIXED_DUAL_ROLE |
                                                     PDO_FIXED_USB_COMM |
                                                     PDO_FIXED_DATA_SWAP)>;
                sink-pdos = <PDO_FIXED(5000, 3000, PDO_FIXED_DUAL_ROLE |
                                                   PDO_FIXED_USB_COMM |
                                                   PDO_FIXED_DATA_SWAP)>;
                op-sink-microwatt = <10000000>;

                port {
                    typec_hs_in: endpoint {
                        remote-endpoint = <&usb_dwc3_hs>;
                    };
                };
            };
        };
    };
...
```
